/* Copyright (c) 2012-2013, The Linux Foundation. All rights reserved.
 *
 * This program is free software; you can redistribute it and/or modify
 * it under the terms of the GNU General Public License version 2 and
 * only version 2 as published by the Free Software Foundation.
 *
 * This program is distributed in the hope that it will be useful,
 * but WITHOUT ANY WARRANTY; without even the implied warranty of
 * MERCHANTABILITY or FITNESS FOR A PARTICULAR PURPOSE.  See the
 * GNU General Public License for more details.
 */

/*---------------------------------------------------------------------------
 * This file is autogenerated file using gcdb parser. Please do not edit it.
 * Update input XML file to add a new entry or update variable in this file
 * VERSION = "1.0"
 *---------------------------------------------------------------------------*/
&mdss_mdp {

    dsi_nt35595_1080_video: qcom,mdss_dsi_nt35595_1080p_video {
        qcom,cont-splash-enabled = <1>;
        qcom,mdss-dsi-panel-name = "a91 Innolux 1080p video mode dsi panel";
        qcom,mdss-dsi-panel-controller = <&mdss_dsi0>;
        qcom,mdss-dsi-panel-type = "dsi_video_mode";
        qcom,mdss-dsi-panel-destination = "display_1";
        qcom,mdss-dsi-panel-framerate = <60>;
        qcom,mdss-dsi-virtual-channel-id = <0>;
        qcom,mdss-dsi-stream = <0>;
        qcom,mdss-dsi-panel-width = <1080>;
        qcom,mdss-dsi-panel-height = <1920>;
        qcom,mdss-dsi-h-front-porch = <32>;
        qcom,mdss-dsi-h-back-porch = <32>;
        qcom,mdss-dsi-h-pulse-width = <8>;
        qcom,mdss-dsi-h-sync-skew = <0>;
        qcom,mdss-dsi-v-back-porch = <6>;
        qcom,mdss-dsi-v-front-porch = <8>;
        qcom,mdss-dsi-v-pulse-width = <2>;
        qcom,mdss-dsi-h-left-border = <0>;
        qcom,mdss-dsi-h-right-border = <0>;
        qcom,mdss-dsi-v-top-border = <0>;
        qcom,mdss-dsi-v-bottom-border = <0>;
        qcom,mdss-dsi-bpp = <24>;
        qcom,mdss-dsi-color-order = <0>;
        qcom,mdss-dsi-underflow-color = <0xff>;
        qcom,mdss-dsi-border-color = <0>;

        qcom,mdss-dsi-on-command = [
        /*dtype last vc ack wait(msleep) dlen *payload */
            15 01 00 00 00 00 02 FF 20
            15 01 00 00 00 00 02 00 01
            15 01 00 00 00 00 02 01 55
            15 01 00 00 00 00 02 02 45
            15 01 00 00 00 00 02 03 55
            15 01 00 00 00 00 02 05 50
            15 01 00 00 00 00 02 06 BC
            15 01 00 00 00 00 02 07 9E
            15 01 00 00 00 00 02 08 0C
            15 01 00 00 00 00 02 0B D7
            15 01 00 00 00 00 02 0C D7
            15 01 00 00 00 00 02 0E BF
            15 01 00 00 00 00 02 0F 9A
            15 01 00 00 00 00 02 11 13
            15 01 00 00 00 00 02 12 13
            15 01 00 00 00 00 02 13 83
            15 01 00 00 00 00 02 14 0A
            15 01 00 00 00 00 02 15 1A
            15 01 00 00 00 00 02 16 1A
            15 01 00 00 00 00 02 23 00
            15 01 00 00 00 00 02 24 00
            15 01 00 00 00 00 02 25 00
            15 01 00 00 00 00 02 26 00
            15 01 00 00 00 00 02 27 00
            15 01 00 00 00 00 02 28 00
            15 01 00 00 00 00 02 30 60
            15 01 00 00 00 00 02 31 52
            15 01 00 00 00 00 02 32 3D
            15 01 00 00 00 00 02 35 00
            15 01 00 00 00 00 02 69 AA
            15 01 00 00 00 00 02 6A 33
            15 01 00 00 00 00 02 6B 40
            15 01 00 00 00 00 02 6C 33
            15 01 00 00 00 00 02 6D 33
            15 01 00 00 00 00 02 72 11
            15 01 00 00 00 00 02 75 00
            15 01 00 00 00 00 02 76 A8
            15 01 00 00 00 00 02 77 00
            15 01 00 00 00 00 02 78 BA
            15 01 00 00 00 00 02 79 00
            15 01 00 00 00 00 02 7A D7
            15 01 00 00 00 00 02 7B 00
            15 01 00 00 00 00 02 7C EF
            15 01 00 00 00 00 02 7D 01
            15 01 00 00 00 00 02 7E 02
            15 01 00 00 00 00 02 7F 01
            15 01 00 00 00 00 02 80 13
            15 01 00 00 00 00 02 81 01
            15 01 00 00 00 00 02 82 21
            15 01 00 00 00 00 02 83 01
            15 01 00 00 00 00 02 84 2F
            15 01 00 00 00 00 02 85 01
            15 01 00 00 00 00 02 86 3D
            15 01 00 00 00 00 02 87 01
            15 01 00 00 00 00 02 88 67
            15 01 00 00 00 00 02 89 01
            15 01 00 00 00 00 02 8A 89
            15 01 00 00 00 00 02 8B 01
            15 01 00 00 00 00 02 8C BF
            15 01 00 00 00 00 02 8D 01
            15 01 00 00 00 00 02 8E EA
            15 01 00 00 00 00 02 8F 02
            15 01 00 00 00 00 02 90 2C
            15 01 00 00 00 00 02 91 02
            15 01 00 00 00 00 02 92 60
            15 01 00 00 00 00 02 93 02
            15 01 00 00 00 00 02 94 62
            15 01 00 00 00 00 02 95 02
            15 01 00 00 00 00 02 96 92
            15 01 00 00 00 00 02 97 02
            15 01 00 00 00 00 02 98 C4
            15 01 00 00 00 00 02 99 02
            15 01 00 00 00 00 02 9A E1
            15 01 00 00 00 00 02 9B 03
            15 01 00 00 00 00 02 9C 06
            15 01 00 00 00 00 02 9D 03
            15 01 00 00 00 00 02 9E 21
            15 01 00 00 00 00 02 9F 03
            15 01 00 00 00 00 02 A0 41
            15 01 00 00 00 00 02 A2 03
            15 01 00 00 00 00 02 A3 4B
            15 01 00 00 00 00 02 A4 03
            15 01 00 00 00 00 02 A5 56
            15 01 00 00 00 00 02 A6 03
            15 01 00 00 00 00 02 A7 63
            15 01 00 00 00 00 02 A9 03
            15 01 00 00 00 00 02 AA 70
            15 01 00 00 00 00 02 AB 03
            15 01 00 00 00 00 02 AC 7E
            15 01 00 00 00 00 02 AD 03
            15 01 00 00 00 00 02 AE 8C
            15 01 00 00 00 00 02 AF 03
            15 01 00 00 00 00 02 B0 93
            15 01 00 00 00 00 02 B1 03
            15 01 00 00 00 00 02 B2 96 
            15 01 00 00 00 00 02 B3 00 
            15 01 00 00 00 00 02 B4 A8 
            15 01 00 00 00 00 02 B5 00 
            15 01 00 00 00 00 02 B6 BA 
            15 01 00 00 00 00 02 B7 00 
            15 01 00 00 00 00 02 B8 D7 
            15 01 00 00 00 00 02 B9 00 
            15 01 00 00 00 00 02 BA EF 
            15 01 00 00 00 00 02 BB 01 
            15 01 00 00 00 00 02 BC 02 
            15 01 00 00 00 00 02 BD 01 
            15 01 00 00 00 00 02 BE 13 
            15 01 00 00 00 00 02 BF 01 
            15 01 00 00 00 00 02 C0 21 
            15 01 00 00 00 00 02 C1 01 
            15 01 00 00 00 00 02 C2 2F 
            15 01 00 00 00 00 02 C3 01 
            15 01 00 00 00 00 02 C4 3D 
            15 01 00 00 00 00 02 C5 01 
            15 01 00 00 00 00 02 C6 67 
            15 01 00 00 00 00 02 C7 01 
            15 01 00 00 00 00 02 C8 89 
            15 01 00 00 00 00 02 C9 01 
            15 01 00 00 00 00 02 CA BF 
            15 01 00 00 00 00 02 CB 01 
            15 01 00 00 00 00 02 CC EA 
            15 01 00 00 00 00 02 CD 02 
            15 01 00 00 00 00 02 CE 2C 
            15 01 00 00 00 00 02 CF 02 
            15 01 00 00 00 00 02 D0 60 
            15 01 00 00 00 00 02 D1 02 
            15 01 00 00 00 00 02 D2 62 
            15 01 00 00 00 00 02 D3 02 
            15 01 00 00 00 00 02 D4 92 
            15 01 00 00 00 00 02 D5 02 
            15 01 00 00 00 00 02 D6 C4 
            15 01 00 00 00 00 02 D7 02 
            15 01 00 00 00 00 02 D8 E1 
            15 01 00 00 00 00 02 D9 03 
            15 01 00 00 00 00 02 DA 06 
            15 01 00 00 00 00 02 DB 03 
            15 01 00 00 00 00 02 DC 21 
            15 01 00 00 00 00 02 DD 03 
            15 01 00 00 00 00 02 DE 41 
            15 01 00 00 00 00 02 DF 03 
            15 01 00 00 00 00 02 E0 4B 
            15 01 00 00 00 00 02 E1 03 
            15 01 00 00 00 00 02 E2 56 
            15 01 00 00 00 00 02 E3 03 
            15 01 00 00 00 00 02 E4 63 
            15 01 00 00 00 00 02 E5 03 
            15 01 00 00 00 00 02 E6 70 
            15 01 00 00 00 00 02 E7 03 
            15 01 00 00 00 00 02 E8 7E 
            15 01 00 00 00 00 02 E9 03 
            15 01 00 00 00 00 02 EA 8C 
            15 01 00 00 00 00 02 EB 03 
            15 01 00 00 00 00 02 EC 93 
            15 01 00 00 00 00 02 ED 03 
            15 01 00 00 00 00 02 EE 96
            15 01 00 00 00 00 02 EF 00
            15 01 00 00 00 00 02 F0 A8
            15 01 00 00 00 00 02 F1 00
            15 01 00 00 00 00 02 F2 BA
            15 01 00 00 00 00 02 F3 00
            15 01 00 00 00 00 02 F4 D7
            15 01 00 00 00 00 02 F5 00
            15 01 00 00 00 00 02 F6 EF
            15 01 00 00 00 00 02 F7 01
            15 01 00 00 00 00 02 F8 02
            15 01 00 00 00 00 02 F9 01
            15 01 00 00 00 00 02 FA 13
            15 01 00 00 00 00 02 FB 01
            15 01 00 00 00 00 02 FF 21
            15 01 00 00 00 00 02 00 01
            15 01 00 00 00 00 02 01 21
            15 01 00 00 00 00 02 02 01
            15 01 00 00 00 00 02 03 2F
            15 01 00 00 00 00 02 04 01
            15 01 00 00 00 00 02 05 3D
            15 01 00 00 00 00 02 06 01
            15 01 00 00 00 00 02 07 67
            15 01 00 00 00 00 02 08 01
            15 01 00 00 00 00 02 09 89
            15 01 00 00 00 00 02 0A 01
            15 01 00 00 00 00 02 0B BF
            15 01 00 00 00 00 02 0C 01
            15 01 00 00 00 00 02 0D EA
            15 01 00 00 00 00 02 0E 02
            15 01 00 00 00 00 02 0F 2C
            15 01 00 00 00 00 02 10 02
            15 01 00 00 00 00 02 11 60
            15 01 00 00 00 00 02 12 02
            15 01 00 00 00 00 02 13 62
            15 01 00 00 00 00 02 14 02
            15 01 00 00 00 00 02 15 92
            15 01 00 00 00 00 02 16 02
            15 01 00 00 00 00 02 17 C4
            15 01 00 00 00 00 02 18 02
            15 01 00 00 00 00 02 19 E1
            15 01 00 00 00 00 02 1A 03
            15 01 00 00 00 00 02 1B 06
            15 01 00 00 00 00 02 1C 03
            15 01 00 00 00 00 02 1D 21
            15 01 00 00 00 00 02 1E 03
            15 01 00 00 00 00 02 1F 41
            15 01 00 00 00 00 02 20 03
            15 01 00 00 00 00 02 21 4B
            15 01 00 00 00 00 02 22 03
            15 01 00 00 00 00 02 23 56
            15 01 00 00 00 00 02 24 03
            15 01 00 00 00 00 02 25 63
            15 01 00 00 00 00 02 26 03
            15 01 00 00 00 00 02 27 70
            15 01 00 00 00 00 02 28 03
            15 01 00 00 00 00 02 29 7E
            15 01 00 00 00 00 02 2A 03
            15 01 00 00 00 00 02 2B 8C
            15 01 00 00 00 00 02 2D 03
            15 01 00 00 00 00 02 2F 93
            15 01 00 00 00 00 02 30 03
            15 01 00 00 00 00 02 31 96
            15 01 00 00 00 00 02 32 00
            15 01 00 00 00 00 02 33 A8
            15 01 00 00 00 00 02 34 00
            15 01 00 00 00 00 02 35 BA
            15 01 00 00 00 00 02 36 00
            15 01 00 00 00 00 02 37 D7
            15 01 00 00 00 00 02 38 00
            15 01 00 00 00 00 02 39 EF
            15 01 00 00 00 00 02 3A 01
            15 01 00 00 00 00 02 3B 02
            15 01 00 00 00 00 02 3D 01
            15 01 00 00 00 00 02 3F 13
            15 01 00 00 00 00 02 40 01
            15 01 00 00 00 00 02 41 21
            15 01 00 00 00 00 02 42 01
            15 01 00 00 00 00 02 43 2F
            15 01 00 00 00 00 02 44 01
            15 01 00 00 00 00 02 45 3D
            15 01 00 00 00 00 02 46 01
            15 01 00 00 00 00 02 47 67
            15 01 00 00 00 00 02 48 01
            15 01 00 00 00 00 02 49 89
            15 01 00 00 00 00 02 4A 01
            15 01 00 00 00 00 02 4B BF
            15 01 00 00 00 00 02 4C 01
            15 01 00 00 00 00 02 4D EA
            15 01 00 00 00 00 02 4E 02
            15 01 00 00 00 00 02 4F 2C
            15 01 00 00 00 00 02 50 02
            15 01 00 00 00 00 02 51 60
            15 01 00 00 00 00 02 52 02
            15 01 00 00 00 00 02 53 62
            15 01 00 00 00 00 02 54 02
            15 01 00 00 00 00 02 55 92
            15 01 00 00 00 00 02 56 02
            15 01 00 00 00 00 02 58 C4
            15 01 00 00 00 00 02 59 02
            15 01 00 00 00 00 02 5A E1
            15 01 00 00 00 00 02 5B 03
            15 01 00 00 00 00 02 5C 06
            15 01 00 00 00 00 02 5D 03
            15 01 00 00 00 00 02 5E 21
            15 01 00 00 00 00 02 5F 03
            15 01 00 00 00 00 02 60 41
            15 01 00 00 00 00 02 61 03
            15 01 00 00 00 00 02 62 4B
            15 01 00 00 00 00 02 63 03
            15 01 00 00 00 00 02 64 56
            15 01 00 00 00 00 02 65 03
            15 01 00 00 00 00 02 66 63
            15 01 00 00 00 00 02 67 03
            15 01 00 00 00 00 02 68 70
            15 01 00 00 00 00 02 69 03
            15 01 00 00 00 00 02 6A 7E
            15 01 00 00 00 00 02 6B 03
            15 01 00 00 00 00 02 6C 8C
            15 01 00 00 00 00 02 6D 03
            15 01 00 00 00 00 02 6E 93
            15 01 00 00 00 00 02 6F 03
            15 01 00 00 00 00 02 70 96
            15 01 00 00 00 00 02 71 00
            15 01 00 00 00 00 02 72 A8
            15 01 00 00 00 00 02 73 00
            15 01 00 00 00 00 02 74 BA
            15 01 00 00 00 00 02 75 00
            15 01 00 00 00 00 02 76 D7
            15 01 00 00 00 00 02 77 00
            15 01 00 00 00 00 02 78 EF
            15 01 00 00 00 00 02 79 01
            15 01 00 00 00 00 02 7A 02
            15 01 00 00 00 00 02 7B 01
            15 01 00 00 00 00 02 7C 13
            15 01 00 00 00 00 02 7D 01
            15 01 00 00 00 00 02 7E 21
            15 01 00 00 00 00 02 7F 01
            15 01 00 00 00 00 02 80 2F
            15 01 00 00 00 00 02 81 01
            15 01 00 00 00 00 02 82 3D
            15 01 00 00 00 00 02 83 01
            15 01 00 00 00 00 02 84 67
            15 01 00 00 00 00 02 85 01
            15 01 00 00 00 00 02 86 89
            15 01 00 00 00 00 02 87 01
            15 01 00 00 00 00 02 88 BF
            15 01 00 00 00 00 02 89 01
            15 01 00 00 00 00 02 8A EA
            15 01 00 00 00 00 02 8B 02
            15 01 00 00 00 00 02 8C 2C
            15 01 00 00 00 00 02 8D 02
            15 01 00 00 00 00 02 8E 60
            15 01 00 00 00 00 02 8F 02
            15 01 00 00 00 00 02 90 62
            15 01 00 00 00 00 02 91 02
            15 01 00 00 00 00 02 92 92
            15 01 00 00 00 00 02 93 02
            15 01 00 00 00 00 02 94 C4
            15 01 00 00 00 00 02 95 02
            15 01 00 00 00 00 02 96 E1
            15 01 00 00 00 00 02 97 03
            15 01 00 00 00 00 02 98 06
            15 01 00 00 00 00 02 99 03
            15 01 00 00 00 00 02 9A 21
            15 01 00 00 00 00 02 9B 03
            15 01 00 00 00 00 02 9C 41
            15 01 00 00 00 00 02 9D 03
            15 01 00 00 00 00 02 9E 4B
            15 01 00 00 00 00 02 9F 03
            15 01 00 00 00 00 02 A0 56
            15 01 00 00 00 00 02 A2 03
            15 01 00 00 00 00 02 A3 63
            15 01 00 00 00 00 02 A4 03
            15 01 00 00 00 00 02 A5 70
            15 01 00 00 00 00 02 A6 03
            15 01 00 00 00 00 02 A7 7E
            15 01 00 00 00 00 02 A9 03
            15 01 00 00 00 00 02 AA 8C
            15 01 00 00 00 00 02 AB 03
            15 01 00 00 00 00 02 AC 93
            15 01 00 00 00 00 02 AD 03
            15 01 00 00 00 00 02 AE 96
            15 01 00 00 00 00 02 AF 00
            15 01 00 00 00 00 02 B0 A8
            15 01 00 00 00 00 02 B1 00
            15 01 00 00 00 00 02 B2 BA
            15 01 00 00 00 00 02 B3 00
            15 01 00 00 00 00 02 B4 D7
            15 01 00 00 00 00 02 B5 00
            15 01 00 00 00 00 02 B6 EF
            15 01 00 00 00 00 02 B7 01
            15 01 00 00 00 00 02 B8 02
            15 01 00 00 00 00 02 B9 01
            15 01 00 00 00 00 02 BA 13
            15 01 00 00 00 00 02 BB 01
            15 01 00 00 00 00 02 BC 21
            15 01 00 00 00 00 02 BD 01
            15 01 00 00 00 00 02 BE 2F
            15 01 00 00 00 00 02 BF 01
            15 01 00 00 00 00 02 C0 3D
            15 01 00 00 00 00 02 C1 01
            15 01 00 00 00 00 02 C2 67
            15 01 00 00 00 00 02 C3 01
            15 01 00 00 00 00 02 C4 89
            15 01 00 00 00 00 02 C5 01
            15 01 00 00 00 00 02 C6 BF
            15 01 00 00 00 00 02 C7 01
            15 01 00 00 00 00 02 C8 EA
            15 01 00 00 00 00 02 C9 02
            15 01 00 00 00 00 02 CA 2C
            15 01 00 00 00 00 02 CB 02
            15 01 00 00 00 00 02 CC 60
            15 01 00 00 00 00 02 CD 02
            15 01 00 00 00 00 02 CE 62
            15 01 00 00 00 00 02 CF 02
            15 01 00 00 00 00 02 D0 92
            15 01 00 00 00 00 02 D1 02
            15 01 00 00 00 00 02 D2 C4
            15 01 00 00 00 00 02 D3 02
            15 01 00 00 00 00 02 D4 E1
            15 01 00 00 00 00 02 D5 03
            15 01 00 00 00 00 02 D6 06
            15 01 00 00 00 00 02 D7 03
            15 01 00 00 00 00 02 D8 21
            15 01 00 00 00 00 02 D9 03
            15 01 00 00 00 00 02 DA 41
            15 01 00 00 00 00 02 DB 03
            15 01 00 00 00 00 02 DC 4B
            15 01 00 00 00 00 02 DD 03
            15 01 00 00 00 00 02 DE 56
            15 01 00 00 00 00 02 DF 03
            15 01 00 00 00 00 02 E0 63
            15 01 00 00 00 00 02 E1 03
            15 01 00 00 00 00 02 E2 70
            15 01 00 00 00 00 02 E3 03
            15 01 00 00 00 00 02 E4 7E
            15 01 00 00 00 00 02 E5 03
            15 01 00 00 00 00 02 E6 8C
            15 01 00 00 00 00 02 E7 03
            15 01 00 00 00 00 02 E8 93
            15 01 00 00 00 00 02 E9 03
            15 01 00 00 00 00 02 EA 96
            15 01 00 00 00 00 02 FB 01
            15 01 00 00 00 00 02 FF 24
            15 01 00 00 00 00 02 00 01
            15 01 00 00 00 00 02 01 03
            15 01 00 00 00 00 02 02 04
            15 01 00 00 00 00 02 03 05
            15 01 00 00 00 00 02 04 06
            15 01 00 00 00 00 02 05 00
            15 01 00 00 00 00 02 06 00
            15 01 00 00 00 00 02 07 0F
            15 01 00 00 00 00 02 08 10
            15 01 00 00 00 00 02 09 0D
            15 01 00 00 00 00 02 0A 13
            15 01 00 00 00 00 02 0B 14
            15 01 00 00 00 00 02 0C 15
            15 01 00 00 00 00 02 0D 16
            15 01 00 00 00 00 02 0E 17
            15 01 00 00 00 00 02 0F 18
            15 01 00 00 00 00 02 10 01
            15 01 00 00 00 00 02 11 03
            15 01 00 00 00 00 02 12 04
            15 01 00 00 00 00 02 13 05
            15 01 00 00 00 00 02 14 06
            15 01 00 00 00 00 02 15 00
            15 01 00 00 00 00 02 16 00
            15 01 00 00 00 00 02 17 0F
            15 01 00 00 00 00 02 18 10
            15 01 00 00 00 00 02 19 0D
            15 01 00 00 00 00 02 1A 13
            15 01 00 00 00 00 02 1B 14
            15 01 00 00 00 00 02 1C 15
            15 01 00 00 00 00 02 1D 16
            15 01 00 00 00 00 02 1E 17   
            15 01 00 00 00 00 02 1F 18
            15 01 00 00 00 00 02 20 49
            15 01 00 00 00 00 02 21 03
            15 01 00 00 00 00 02 22 01
            15 01 00 00 00 00 02 23 00
            15 01 00 00 00 00 02 24 68
            15 01 00 00 00 00 02 26 00
            15 01 00 00 00 00 02 27 62
            15 01 00 00 00 00 02 25 5D
            15 01 00 00 00 00 02 2F 02
            15 01 00 00 00 00 02 30 23
            15 01 00 00 00 00 02 31 49
            15 01 00 00 00 00 02 32 48
            15 01 00 00 00 00 02 33 41
            15 01 00 00 00 00 02 34 01
            15 01 00 00 00 00 02 35 75
            15 01 00 00 00 00 02 36 00
            15 01 00 00 00 00 02 37 1D
            15 01 00 00 00 00 02 38 08
            15 01 00 00 00 00 02 39 01
            15 01 00 00 00 00 02 3A 6F
            15 01 00 00 00 00 02 5B 54
            15 01 00 00 00 00 02 5C 00
            15 01 00 00 00 00 02 5D 00
            15 01 00 00 00 00 02 5E 00
            15 01 00 00 00 00 02 5F 6D
            15 01 00 00 00 00 02 60 6D
            15 01 00 00 00 00 02 61 00
            15 01 00 00 00 00 02 62 00
            15 01 00 00 00 00 02 63 00
            15 01 00 00 00 00 02 64 00
            15 01 00 00 00 00 02 65 00
            15 01 00 00 00 00 02 66 00
            15 01 00 00 00 00 02 67 04
            15 01 00 00 00 00 02 68 02
            15 01 00 00 00 00 02 69 04
            15 01 00 00 00 00 02 6A 04
            15 01 00 00 00 00 02 F4 D0
            15 01 00 00 00 00 02 F5 01
            15 01 00 00 00 00 02 F6 01
            15 01 00 00 00 00 02 F7 00
            15 01 00 00 00 00 02 F8 01
            15 01 00 00 00 00 02 F9 00
            15 01 00 00 00 00 02 74 02
            15 01 00 00 00 00 02 75 1A
            15 01 00 00 00 00 02 76 04
            15 01 00 00 00 00 02 77 03
            15 01 00 00 00 00 02 7A 00
            15 01 00 00 00 00 02 7B 91
            15 01 00 00 00 00 02 7C D8
            15 01 00 00 00 00 02 7D 50
            15 01 00 00 00 00 02 7E 02
            15 01 00 00 00 00 02 7F 1C
            15 01 00 00 00 00 02 81 04
            15 01 00 00 00 00 02 82 03
            15 01 00 00 00 00 02 86 1B
            15 01 00 00 00 00 02 87 1B
            15 01 00 00 00 00 02 88 1B
            15 01 00 00 00 00 02 89 1B
            15 01 00 00 00 00 02 8A 00
            15 01 00 00 00 00 02 8B 00
            15 01 00 00 00 00 02 8C 00
            15 01 00 00 00 00 02 8E 08  /*  VFP */
            15 01 00 00 00 00 02 8F 08  /*  VBP */
            15 01 00 00 00 00 02 90 72
            15 01 00 00 00 00 02 91 44
            15 01 00 00 00 00 02 92 79
            15 01 00 00 00 00 02 93 08
            15 01 00 00 00 00 02 94 08
            15 01 00 00 00 00 02 95 79
            15 01 00 00 00 00 02 96 79
            15 01 00 00 00 00 02 9B 0F
            15 01 00 00 00 00 02 9D 30
            15 01 00 00 00 00 02 B3 28
            15 01 00 00 00 00 02 B4 0A
            15 01 00 00 00 00 02 B5 45
            15 01 00 00 00 00 02 FB 01
            /* CMD2 Page3, CABC function    */
            15 01 00 00 02 00 02 FF 23
            /*  PWMfreq = 42000 / ((256+6)*4) = 40k */
            15 01 00 00 00 00 02 07 20          /*  42 MHZ   */
            15 01 00 00 00 00 02 08 04          /*  div = 4  */
            15 01 00 00 00 00 02 46 06          /*  duty cnt = 6 */
            15 01 00 00 00 00 02 05 29          /*  dimming step 64 steps */
            15 01 00 00 00 00 02 21 ED          /*  93 %   */
            15 01 00 00 00 00 02 22 D3          /*  83 %   */ 
            15 01 00 00 00 00 02 23 C6          /*  78 %   */ 
            15 01 00 00 00 00 02 24 B9          /*  73 %   */ 
            15 01 00 00 00 00 02 25 AD          /*  68 %   */ 
            15 01 00 00 00 00 02 26 A0          /*  63 %   */ 
            15 01 00 00 00 00 02 27 89          /*  54 %   */ 
            15 01 00 00 00 00 02 28 79          /*  48 %   */ 
            15 01 00 00 00 00 02 29 72          /*  45 %   */ 
            15 01 00 00 00 00 02 2A 5D          /*  37 %   */
            15 01 00 00 00 00 02 FB 01          /*  Don't Reload MTP */
            /*  CMD1    */
            15 01 00 00 02 00 02 FF 10
            29 01 00 00 00 00 04 3B 03 08 08    /* VBP, VFP, HBP, HFP */
            15 01 00 00 00 00 02 51 64
            15 01 00 00 00 00 02 53 2c
            15 01 00 00 00 00 02 55 03
            15 01 00 00 05 00 02 BB 03
            05 01 00 00 82 00 02 11 00          /* exit sleep */
            05 01 00 00 00 00 02 29 00          /* display on */
        ];

        qcom,mdss-dsi-off-command = [
                 15 01 00 00 00 00 02 51 00
                 05 01 00 00 32 00 02 28 00
                 05 01 00 00 78 00 02 10 00
        ];
        qcom,mdss-dsi-on-command-state = "dsi_lp_mode";
        qcom,mdss-dsi-off-command-state = "dsi_hs_mode";
        qcom,mdss-dsi-h-sync-pulse = <0>;
	qcom,mdss-dsi-traffic-mode = "non_burst_sync_event";
        qcom,mdss-dsi-bllp-eof-power-mode;
        qcom,mdss-dsi-bllp-power-mode;
        qcom,mdss-dsi-lane-0-state;
        qcom,mdss-dsi-lane-1-state;
        qcom,mdss-dsi-lane-2-state;
        qcom,mdss-dsi-lane-3-state;
        qcom,mdss-dsi-panel-timings = [f0 3c 22 00 60 5a 32 3c 29 03 04 a0];
        qcom,mdss-dsi-t-clk-post = <0x05>;
        qcom,mdss-dsi-t-clk-pre = <0x2B>;
        qcom,mdss-dsi-bl-min-level = <5>;
        qcom,mdss-dsi-bl-max-level = <255>;
		qcom,mdss-dsi-dma-trigger = "trigger_sw";
		qcom,mdss-dsi-mdp-trigger = "none";
        qcom,mdss-dsi-bl-pmic-control-type = "bl_ctrl_dcs";
        qcom,mdss-dsi-pan-enable-dynamic-fps;
        qcom,mdss-dsi-pan-fps-update = "dfps_suspend_resume_mode";
        qcom,mdss-dsi-reset-sequence = <1 0>, <0 10>, <1 15>;   //msleep
	qcom,mdss-pan-physical-width-dimension = <62>; //width of picture in mm (for xdpi)
	qcom,mdss-pan-physical-height-dimension = <110>; //height of picture in mm (for ydpi)
	//qcom,panel-roi-alignment = <900 4 2 4 540 20>;
	//qcom,ulps-enabled;
    };
};

