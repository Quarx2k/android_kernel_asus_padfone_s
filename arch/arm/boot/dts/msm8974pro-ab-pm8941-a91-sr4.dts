/* Copyright (c) 2013, The Linux Foundation. All rights reserved.
 *
 * This program is free software; you can redistribute it and/or modify
 * it under the terms of the GNU General Public License version 2 and
 * only version 2 as published by the Free Software Foundation.
 *
 * This program is distributed in the hope that it will be useful,
 * but WITHOUT ANY WARRANTY; without even the implied warranty of
 * MERCHANTABILITY or FITNESS FOR A PARTICULAR PURPOSE.  See the
 * GNU General Public License for more details.
 */

/dts-v1/;

/include/ "msm8974pro-ab-pm8941.dtsi"
/include/ "asus/msm8974-a91-sr4.dtsi"

/ {
	model = "Qualcomm MSM 8974Pro-AA/AB CDP";
	compatible = "qcom,msm8974-cdp", "qcom,msm8974", "qcom,cdp";
	qcom,board-id = <33 0>;	//ASUS_BSP : add for ASUS DT ID : a91-sr4
};
