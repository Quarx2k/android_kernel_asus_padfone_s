/* Copyright (c) 2013-2014, The Linux Foundation. All rights reserved.
 *
 * This program is free software; you can redistribute it and/or modify
 * it under the terms of the GNU General Public License version 2 and
 * only version 2 as published by the Free Software Foundation.
 *
 * This program is distributed in the hope that it will be useful,
 * but WITHOUT ANY WARRANTY; without even the implied warranty of
 * MERCHANTABILITY or FITNESS FOR A PARTICULAR PURPOSE.  See the
 * GNU General Public License for more details.
 */

/dts-v1/;

//+++ ASUS_BSP : modify from msm8974pro-ab-pm8941-cdp.dts
///include/ "msm8974pro-ab-pm8941.dtsi"
///include/ "msm8974-cdp.dtsi"
/include/ "msm8974pro-ab-pm8941-asus-a90-evb.dtsi"
/include/ "msm8974-a90-evb.dtsi"
//--- ASUS_BSP : modify from msm8974pro-ab-pm8941-cdp.dts

/ {
	model = "Qualcomm MSM 8974Pro-AA/AB CDP";
	compatible = "qcom,msm8974-cdp", "qcom,msm8974", "qcom,cdp";
	qcom,board-id = <21 0>;	//ASUS_BSP : add for ASUS DT ID : a90-evb
};

&sdhc_1 {
	qcom,pad-pull-on = <0x0 0x3 0x3 0x1>; /* no-pull, pull-up, pull-up, pull-down */
	qcom,pad-pull-off = <0x0 0x3 0x3 0x1>; /* no-pull, pull-up, pull-up, pull-down */
};

&ehci {
	hsusb_vdd_dig-supply = <&pm8841_s2_corner>;
	qcom,vdd-voltage-level = <1 2 3 5 7>;
};
