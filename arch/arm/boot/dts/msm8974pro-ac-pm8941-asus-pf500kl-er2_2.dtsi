/* Copyright (c) 2013, The Linux Foundation. All rights reserved.
 *
 * This program is free software; you can redistribute it and/or modify
 * it under the terms of the GNU General Public License version 2 and
 * only version 2 as published by the Free Software Foundation.
 *
 * This program is distributed in the hope that it will be useful,
 * but WITHOUT ANY WARRANTY; without even the implied warranty of
 * MERCHANTABILITY or FITNESS FOR A PARTICULAR PURPOSE.  See the
 * GNU General Public License for more details.
 */

//+++ ASUS_BSP : modify from msm8974pro-ac-pm8941.dtsi
///include/ "msm8974pro-pm8941.dtsi"
/include/ "msm8974pro-pm8941-asus-pf500kl-er2_2.dtsi"
//--- ASUS_BSP : modify from msm8974pro-ac-pm8941.dtsi

/ {
	qcom,msm-id = <194 0x10000>;	//ASUS_BSP : add for ASUS DT ID MSM8974AC
};

&sdhc_1 {
	reg = <0xf9824900 0x1a0>, <0xf9824000 0x800>;
};
