/* Copyright (c) 2012-2013, The Linux Foundation. All rights reserved.
 *
 * This program is free software; you can redistribute it and/or modify
 * it under the terms of the GNU General Public License version 2 and
 * only version 2 as published by the Free Software Foundation.
 *
 * This program is distributed in the hope that it will be useful,
 * but WITHOUT ANY WARRANTY; without even the implied warranty of
 * MERCHANTABILITY or FITNESS FOR A PARTICULAR PURPOSE.  See the
 * GNU General Public License for more details.
 */

/*---------------------------------------------------------------------------
 * This file is autogenerated file using gcdb parser. Please do not edit it.
 * Update input XML file to add a new entry or update variable in this file
 * VERSION = "1.0"
 *---------------------------------------------------------------------------*/
&mdss_mdp {

	dsi_sharp_1080_vid: qcom,mdss_dsi_rensas_1080p_video {
        qcom,cont-splash-enabled = <1>;
		qcom,mdss-dsi-panel-name = "a86 sharp 1080p video mode dsi panel";
		qcom,mdss-dsi-panel-controller = <&mdss_dsi0>;
		qcom,mdss-dsi-panel-type = "dsi_video_mode";
		qcom,mdss-dsi-panel-destination = "display_1";
		qcom,mdss-dsi-panel-framerate = <60>;
		qcom,mdss-dsi-virtual-channel-id = <0>;
		qcom,mdss-dsi-stream = <0>;
		qcom,mdss-dsi-panel-width = <1080>;
		qcom,mdss-dsi-panel-height = <1920>;
		qcom,mdss-dsi-h-front-porch = <160>;
		qcom,mdss-dsi-h-back-porch = <50>;
		qcom,mdss-dsi-h-pulse-width = <10>;
		qcom,mdss-dsi-h-sync-skew = <0>;
		qcom,mdss-dsi-v-back-porch = <4>;
		qcom,mdss-dsi-v-front-porch = <4>;
		qcom,mdss-dsi-v-pulse-width = <2>;
		qcom,mdss-dsi-h-left-border = <0>;
		qcom,mdss-dsi-h-right-border = <0>;
		qcom,mdss-dsi-v-top-border = <0>;
		qcom,mdss-dsi-v-bottom-border = <0>;
		qcom,mdss-dsi-bpp = <24>;
		qcom,mdss-dsi-color-order = <0>;
		qcom,mdss-dsi-underflow-color = <0x0>;
		qcom,mdss-dsi-border-color = <0>;

		qcom,mdss-dsi-on-command = [

        /*dtype last vc ack wait(msleep) dlen *payload */
					13 01 00 00 00 00 02 b0 04
                    05 01 00 00 00 00 02 00 00
                    05 01 00 00 00 00 02 00 00
                    13 01 00 00 00 00 02 d6 01
                    39 01 00 00 00 00 03 51 01 00                  /* bl cmd */
                    39 01 00 00 00 00 02 53 2C                     /* bl & dimming dtrl */
                    39 01 00 00 00 00 02 55 03                     /* cabc moving mode */
                    39 01 00 00 00 00 03 5e 00 52                  /* cabc bl min */
                    29 01 00 00 00 00 08 b9 03 30 10 30 9f 1f 80
                    29 01 00 00 00 00 08 ce 00 03 04 c1 5e b2 03
                    29 01 00 00 00 00 04 c3 01 00 0a               /* hsync    */
                    05 01 00 00 00 00 02 29 00                     /* display on */
                    05 01 00 00 80 00 02 11 00                     /* exit sleep */
        ];

		qcom,mdss-dsi-off-command = [
                 39 01 00 00 00 00 03 51 00 00
                 05 01 00 00 32 00 02 28 00
				 05 01 00 00 78 00 02 10 00
        ];
		qcom,mdss-dsi-on-command-state = "dsi_lp_mode";
		qcom,mdss-dsi-off-command-state = "dsi_hs_mode";
		qcom,mdss-dsi-h-sync-pulse = <0>;
		qcom,mdss-dsi-traffic-mode = "non_burst_sync_event";
		qcom,mdss-dsi-lane-map = <0>;
		qcom,mdss-dsi-bllp-eof-power-mode;
		qcom,mdss-dsi-bllp-power-mode;
		qcom,mdss-dsi-lane-0-state;
		qcom,mdss-dsi-lane-1-state;
		qcom,mdss-dsi-lane-2-state;
		qcom,mdss-dsi-lane-3-state;
		qcom,mdss-dsi-panel-timings = [e8 9b 3b 00 78 a6 3d 9c 42 03 04 a0];
		qcom,mdss-dsi-t-clk-post = <0x1a>;
		qcom,mdss-dsi-t-clk-pre = <0x32>;
		qcom,mdss-dsi-bl-min-level = <1>;
		qcom,mdss-dsi-bl-max-level = <255>;
		qcom,mdss-dsi-dma-trigger = "trigger_sw";
		qcom,mdss-dsi-mdp-trigger = "none";
		qcom,mdss-dsi-bl-pmic-control-type = "bl_ctrl_dcs";
		qcom,mdss-dsi-pan-enable-dynamic-fps;
		qcom,mdss-dsi-pan-fps-update = "dfps_suspend_resume_mode";
		qcom,mdss-dsi-reset-sequence = <1 0>, <0 10>, <1 15>;	//msleep
		qcom,mdss-pan-physical-width-dimension = <62>; //width of picture in mm (for xdpi)
		qcom,mdss-pan-physical-height-dimension = <110>; //height of picture in mm (for ydpi)
		qcom,panel-roi-alignment = <900 4 2 4 540 20>;
		qcom,ulps-enabled;
	};
};

