## drivers/media/v4l2-core/Kconfig
```kconfig
#
# Generic video config states
#
if MEDIA_SUPPORT
config VIDEO_V4L2
	tristate
	depends on VIDEO_DEV && VIDEO_V4L2_COMMON
	default VIDEO_DEV && VIDEO_V4L2_COMMON

config VIDEOBUF_GEN
	tristate

config VIDEOBUF_DMA_SG
	depends on HAS_DMA
	select VIDEOBUF_GEN
	tristate

config VIDEOBUF_VMALLOC
	select VIDEOBUF_GEN
	tristate

config VIDEOBUF_DMA_CONTIG
	depends on HAS_DMA
	select VIDEOBUF_GEN
	tristate

config VIDEOBUF_DVB
	tristate
	select VIDEOBUF_GEN

config VIDEO_BTCX
	depends on PCI
	tristate

config VIDEO_TVEEPROM
	tristate
	depends on I2C

config VIDEO_TUNER
	tristate
	depends on MEDIA_TUNER

config V4L2_MEM2MEM_DEV
	tristate
	depends on VIDEOBUF2_CORE

config VIDEOBUF2_CORE
	tristate
	depends on VIDEO_DEV && VIDEO_V4L2_COMMON
	default VIDEO_DEV && VIDEO_V4L2_COMMON

config VIDEOBUF2_MEMOPS
	depends on VIDEO_DEV && VIDEO_V4L2_COMMON
	default VIDEO_DEV && VIDEO_V4L2_COMMON
	tristate

config VIDEOBUF2_DMA_CONTIG
	select VIDEOBUF2_CORE
	select VIDEOBUF2_MEMOPS
	tristate

config VIDEOBUF2_VMALLOC
	depends on VIDEO_DEV && VIDEO_V4L2_COMMON
	default VIDEO_DEV && VIDEO_V4L2_COMMON
	select VIDEOBUF2_CORE
	select VIDEOBUF2_MEMOPS
	tristate


config VIDEOBUF2_DMA_SG
	#depends on HAS_DMA
	select VIDEOBUF2_CORE
	select VIDEOBUF2_MEMOPS
	tristate
endif # MEDIA_SUPPORT
```

## drivers/power/charger/Kconfig
```kconfig
config SMB_346_CHARGER
        bool "Support for Maxim 8934 charger"
        default y 

config DUMMY_CHARGER
        bool "Support for dummy charger"
        default y

config PM_8921_CHARGER
        bool "Support for PM 8921 charger"
        default y

config PM_8941_CHARGER
        bool "Support for PM 8941 charger"
        default y

config IDTP9023_CHARGER
        bool "Support for IDTP 9023 charger"
        default y
```

## drivers/sensors/Kconfig
```kconfig
menu "Sensors driver"

config SENSORS_CM36283
	bool "PS ALS CM36283 support"
	default n
	---help---
	  ASUS SENSORS folder

config SENSORS_CAP1106
	bool "CAP1106 support"
	default n
	---help---
	  ASUS SENSORS folder

config SENSORS
	bool "Asus sensors support"
	default y
	---help---
	  ASUS SENSORS folder

config SENSORS_SSC
	bool "Enable Sensors Driver Support for SSC"
	help
	  Add support for sensors SSC driver.
	  This driver is used for exercising sensors use case,
	  time syncing with ADSP clock.

endmenu
```

## drivers/video/msm/mydp-7808/Kconfig
```kconfig
config SLIMPORT_ANX7808
	bool "Analogix Slimport transmitter ANX7808 support"	
	#default y
	help
	  Slimport Transmitter is a HD video transmitter chip
	  over micro-USB connector for smartphone device.
```
